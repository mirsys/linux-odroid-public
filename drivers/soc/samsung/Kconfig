## drivers/soc/samsung/Kconfig
```kconfig
#
# SAMSUNG SoC drivers
#
menu "Samsung SOC driver support"

config SOC_SAMSUNG
	bool

config EXYNOS_SROM
	bool
	depends on ARM && ARCH_EXYNOS
	select SOC_BUS

endmenu
```
