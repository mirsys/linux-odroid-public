/*
 * Samsung's Exynos4412 SoC Prime device tree source
 *
 * This program is free software; you can redistribute it and/or modify
 * it under the terms of the GNU General Public License version 2 as
 * published by the Free Software Foundation.
*/

&cpu0 {
	exynos4412-prime-variant;

	operating-points = <
		1704000 1375000
		1600000 1350000
		1500000 1300000
		1400000 1225000
		1300000 1175000
		1200000 1125000
		1100000 1075000
		1000000 1037500
		 900000 1012500
		 800000 1000000
		 700000  987500
		 600000  975000
		 500000  950000
		 400000  925000
		 300000  900000
		 200000  900000
	>;
	boost-opps = <
		1800000 1400000
	>;
};
